## layers/meta-hh/conf/layer.conf
```bitbake
# We have a conf and classes directory, add to BBPATH
BBPATH .= ":${LAYERDIR}"

# We have recipes-* directories, add to BBFILES
BBFILES += "${LAYERDIR}/recipes-*/*/*.bb \
        ${LAYERDIR}/recipes-*/*/*.bbappend"

BBFILE_COLLECTIONS += "hh-layer"
BBFILE_PATTERN_hh-layer := "^${LAYERDIR}/"
BBFILE_PRIORITY_hh-layer = "25"

LAYERDEPENDS_hh-layer = "core"

LAYERSERIES_COMPAT_hh-layer = "sumo thud"
```

## layers/meta-hh/conf/machine/include/amlogic-meson32.inc
```bitbake
# Amlogic Meson32 Configurations

SOC_FAMILY = "amlogic:meson8"
require conf/machine/include/amlogic-meson.inc
```

## layers/meta-hh/conf/machine/include/amlogic-meson64.inc
```bitbake
# Amlogic Meson64 Configurations

SOC_FAMILY = "amlogic:meson-gx"
require conf/machine/include/amlogic-meson.inc
require conf/machine/include/arm64/arch-armv8.inc
```

## layers/meta-hh/conf/machine/include/arm64/arch-armv8.inc
```bitbake
DEFAULTTUNE ?= "aarch64"

require conf/machine/include/arm/arch-armv7ve.inc

TUNEVALID[aarch64] = "Enable instructions for aarch64"

MACHINEOVERRIDES .= "${@bb.utils.contains('TUNE_FEATURES', 'aarch64', ':aarch64', '' ,d)}"

TUNEVALID[ilp32] = "Enable instructions for aarch64 32 bit mode"
TUNE_CCARGS .= "${@bb.utils.contains('TUNE_FEATURES', 'ilp32', ' -mabi=ilp32', '', d)}"
MACHINEOVERRIDES .= "${@bb.utils.contains('TUNE_FEATURES', 'ilp32', ':aarchilp32', '' ,d)}"

# Little Endian base configs
AVAILTUNES += "aarch64 aarch64_be aarch64_ilp32 aarch64_be_ilp32"
ARMPKGARCH_tune-aarch64 ?= "aarch64"
ARMPKGARCH_tune-aarch64_be ?= "aarch64_be"
ARMPKGARCH_tune-aarch64_ilp32 ?= "aarch64_ilp32"
ARMPKGARCH_tune-aarch64_be_ilp32 ?= "aarch64_be_ilp32"
TUNE_FEATURES_tune-aarch64 = "aarch64"
TUNE_FEATURES_tune-aarch64_be = "${TUNE_FEATURES_tune-aarch64} bigendian"
TUNE_FEATURES_tune-aarch64_ilp32 ?= "${TUNE_FEATURES_tune-aarch64} ilp32"
TUNE_FEATURES_tune-aarch64_be_ilp32 ?= "${TUNE_FEATURES_tune-aarch64} bigendian ilp32"
BASE_LIB_tune-aarch64 = "lib64"
BASE_LIB_tune-aarch64_be = "lib64"
BASE_LIB_tune-aarch64_ilp32 = "libilp32"

PACKAGE_EXTRA_ARCHS_tune-aarch64 = "aarch64"
PACKAGE_EXTRA_ARCHS_tune-aarch64_be = "aarch64_be"
PACKAGE_EXTRA_ARCHS_tune-aarch64_ilp32 = "aarch64_ilp32"
PACKAGE_EXTRA_ARCHS_tune-aarch64_be_ilp32 = "aarch64_be_ilp32"

ARMPKGSFX_ENDIAN_64 = "${@bb.utils.contains('TUNE_FEATURES', 'bigendian', '_be', '', d)}"
ARMPKGSFX_ILP32 = "${@bb.utils.contains('TUNE_FEATURES', 'ilp32', '_ilp32', '', d)}"
TUNE_ARCH_64 = "aarch64${ARMPKGSFX_ENDIAN_64}${ARMPKGSFX_ILP32}"
TUNE_PKGARCH_64 = "aarch64${ARMPKGSFX_ENDIAN_64}${ARMPKGSFX_ILP32}"
ABIEXTENSION_64 = "${@bb.utils.contains('TUNE_FEATURES', 'ilp32', 'ilp32', '' ,d)}"
TARGET_FPU_64 = ""

# Duplicated from arch-arm.inc
TUNE_ARCH_32 = "${@bb.utils.contains('TUNE_FEATURES', 'bigendian', 'armeb', 'arm', d)}"
TUNE_PKGARCH_32 = "${ARMPKGARCH}${ARMPKGSFX_THUMB}${ARMPKGSFX_DSP}${ARMPKGSFX_EABI}${ARMPKGSFX_ENDIAN}${ARMPKGSFX_FPU}"
ABIEXTENSION_32 = "eabi"
TARGET_FPU_32 = "${@d.getVar('TUNE_CCARGS_MFLOAT') or 'soft'}"

TUNE_ARCH = "${@bb.utils.contains('TUNE_FEATURES', 'aarch64', '${TUNE_ARCH_64}', '${TUNE_ARCH_32}' ,d)}"
TUNE_PKGARCH = "${@bb.utils.contains('TUNE_FEATURES', 'aarch64', '${TUNE_PKGARCH_64}', '${TUNE_PKGARCH_32}' ,d)}"
ABIEXTENSION = "${@bb.utils.contains('TUNE_FEATURES', 'aarch64', '${ABIEXTENSION_64}', '${ABIEXTENSION_32}' ,d)}"
TARGET_FPU = "${@bb.utils.contains('TUNE_FEATURES', 'aarch64', '${TARGET_FPU_64}', '${TARGET_FPU_32}' ,d)}"
```

## layers/meta-hh/conf/machine/include/odroid-arm-defaults.inc
```bitbake
# Odroid BSP Arm default settings
require conf/machine/include/odroid-default-settings.inc

XSERVER_append = " \
    ${@bb.utils.contains('MACHINE_FEATURES', 'mali', 'xserver-xorg-module-exa', '', d)} \
"

KERNEL_IMAGETYPE ?= "zImage"

PREFERRED_PROVIDER_virtual/bootloader ?= "u-boot"
PREFERRED_PROVIDER_u-boot ?= "u-boot"
PREFERRED_VERSION_u-boot ?= "2018.11"

USE_BOOTSRC ?= "1"
UBOOT_ENV  ?= "boot"
UBOOT_BINARY ?= "u-boot-dtb.bin"
UBOOT_ENV_SUFFIX ?= "scr"
UBOOT_SCRIPT ?= "boot.${UBOOT_ENV_SUFFIX}"
UBOOT_LOAD_CMD ?= "ext4load"
UBOOT_BOOT_CMD ?= "bootz"

UBOOT_BOOTDEV  ?= "2"
UBOOT_BOOTPART ?= "2"
UBOOT_ROOTDEV ?= "1"
UBOOT_ROOTPART ?= "2"
UBOOT_BOOTTYPE ?= "mmc"
UBOOT_ROOTTYPE ?= "mmcblk${UBOOT_ROOTDEV}p"
BOOT_PREFIX ?= "boot/"

UBOOT_EXTRA_ENV ?= ""
UBOOT_FILE_TITLE ?= "#"
BOOT_PREFIX ?= ""
UBOOT_VIDEO ?= "${@bb.utils.contains("DISTRO_FEATURES", "x11", "drm.edid_firmware=edid/1024x768.bin", " ", d)}"
UBOOT_XTRA_CMDLINE ?=  "${@bb.utils.contains('DISTRO_FEATURES', 'TS_vu7+', 'usbhid.quirks=0x16B4:0x0703:0x00000040 ', '', d)}"

IMAGE_BOOT_FILES ?= "${UBOOT_SCRIPT}"

MACHINE_FEATURES_append = " mali"

MACHINE_FEATURES_BACKFILL_CONSIDERED = "rtc"

EXTRA_IMAGEDEPENDS_append = " u-boot secure-odroid"
EXTRA_IMAGEDEPENDS_append = " ${@bb.utils.contains("DISTRO_FEATURES", "x11", " odroid-edid", " ", d)}"
IMAGE_INSTALL_append = " kernel-devicetree"

IMAGE_CLASSES += "image_types_odroid"
```

## layers/meta-hh/conf/machine/odroid-xu4-hc2.conf
```bitbake
#@TYPE: Machine
#@NAME: odroid-xu4
#@DESCRIPTION: Machine configuration for odroid-xu4 systems
#@MAINTAINER: Alexandre Tuleu <alexandre.tuleu.2005@polytechnique.org>


include conf/machine/include/odroid-xu-default.inc

KERNEL_DEVICETREE ?= "exynos5422-odroidxu4.dtb"
#UBOOT_MACHINE_odroid-xu4-hc2 = "odroid-xu4-hc2_defconfig"
UBOOT_MACHINE_odroid-xu4-hc2 = "odroid-xu3_defconfig"
```
